## yocto/build/conf/bblayers.conf
```bitbake
# POKY_BBLAYERS_CONF_VERSION is increased each time build/conf/bblayers.conf
# changes incompatibly
POKY_BBLAYERS_CONF_VERSION = "2"

BBPATH = "${TOPDIR}"
BBFILES ?= ""

BBLAYERS ?= " \
  /xilinxworks/ZCU102/v2025.2/r5ctrlr/r5ctrlr/yocto/edf/sources/poky/meta \
  /xilinxworks/ZCU102/v2025.2/r5ctrlr/r5ctrlr/yocto/edf/sources/poky/meta-poky \
  /xilinxworks/ZCU102/v2025.2/r5ctrlr/r5ctrlr/yocto/edf/sources/poky/../meta-openembedded/meta-oe \
  /xilinxworks/ZCU102/v2025.2/r5ctrlr/r5ctrlr/yocto/edf/sources/poky/../meta-openembedded/meta-python \
  /xilinxworks/ZCU102/v2025.2/r5ctrlr/r5ctrlr/yocto/edf/sources/poky/../meta-openembedded/meta-filesystems \
  /xilinxworks/ZCU102/v2025.2/r5ctrlr/r5ctrlr/yocto/edf/sources/poky/../meta-openembedded/meta-networking \
  /xilinxworks/ZCU102/v2025.2/r5ctrlr/r5ctrlr/yocto/edf/sources/poky/../meta-openembedded/meta-multimedia \
  /xilinxworks/ZCU102/v2025.2/r5ctrlr/r5ctrlr/yocto/edf/sources/poky/../meta-openembedded/meta-webserver \
  /xilinxworks/ZCU102/v2025.2/r5ctrlr/r5ctrlr/yocto/edf/sources/poky/../meta-virtualization \
  /xilinxworks/ZCU102/v2025.2/r5ctrlr/r5ctrlr/yocto/edf/sources/poky/../meta-security \
  /xilinxworks/ZCU102/v2025.2/r5ctrlr/r5ctrlr/yocto/edf/sources/poky/../meta-security/meta-tpm \
  /xilinxworks/ZCU102/v2025.2/r5ctrlr/r5ctrlr/yocto/edf/sources/poky/../meta-xilinx/meta-xilinx-core \
  /xilinxworks/ZCU102/v2025.2/r5ctrlr/r5ctrlr/yocto/edf/sources/poky/../meta-xilinx/meta-xilinx-standalone \
  /xilinxworks/ZCU102/v2025.2/r5ctrlr/r5ctrlr/yocto/edf/sources/poky/../meta-xilinx/meta-xilinx-standalone-sdt \
  /xilinxworks/ZCU102/v2025.2/r5ctrlr/r5ctrlr/yocto/edf/sources/poky/../meta-xilinx/meta-xilinx-multimedia \
  /xilinxworks/ZCU102/v2025.2/r5ctrlr/r5ctrlr/yocto/edf/sources/poky/../meta-xilinx/meta-xilinx-demos \
  /xilinxworks/ZCU102/v2025.2/r5ctrlr/r5ctrlr/yocto/edf/sources/poky/../meta-xilinx/meta-xilinx-virtualization \
  /xilinxworks/ZCU102/v2025.2/r5ctrlr/r5ctrlr/yocto/edf/sources/poky/../meta-xilinx/meta-xilinx-mali400 \
  /xilinxworks/ZCU102/v2025.2/r5ctrlr/r5ctrlr/yocto/edf/sources/poky/../meta-xilinx/meta-xilinx-gpu-malig78ae \
  /xilinxworks/ZCU102/v2025.2/r5ctrlr/r5ctrlr/yocto/edf/sources/poky/../meta-xilinx/meta-microblaze \
  /xilinxworks/ZCU102/v2025.2/r5ctrlr/r5ctrlr/yocto/edf/sources/poky/../meta-xilinx/meta-amd-zephyr \
  /xilinxworks/ZCU102/v2025.2/r5ctrlr/r5ctrlr/yocto/edf/sources/poky/../meta-xilinx-tsn \
  /xilinxworks/ZCU102/v2025.2/r5ctrlr/r5ctrlr/yocto/edf/sources/poky/../meta-openamp \
  /xilinxworks/ZCU102/v2025.2/r5ctrlr/r5ctrlr/yocto/edf/sources/poky/../meta-amd-edf \
  /xilinxworks/ZCU102/v2025.2/r5ctrlr/r5ctrlr/yocto/edf/sources/poky/../meta-amd-edf/meta-amd-edf-bsp \
  /xilinxworks/ZCU102/v2025.2/r5ctrlr/r5ctrlr/yocto/edf/sources/poky/../meta-kria \
  /xilinxworks/ZCU102/v2025.2/r5ctrlr/r5ctrlr/yocto/edf/sources/poky/../meta-amd-adaptive-socs/meta-amd-adaptive-socs-core \
  /xilinxworks/ZCU102/v2025.2/r5ctrlr/r5ctrlr/yocto/edf/sources/poky/../meta-amd-adaptive-socs/meta-amd-adaptive-socs-bsp \
  /xilinxworks/ZCU102/v2025.2/r5ctrlr/r5ctrlr/yocto/edf/sources/poky/../meta-xilinx/meta-xilinx-imgrcvry \
  /xilinxworks/ZCU102/v2025.2/r5ctrlr/r5ctrlr/yocto/edf/sources/poky/../meta-arm/meta-arm \
  /xilinxworks/ZCU102/v2025.2/r5ctrlr/r5ctrlr/yocto/edf/sources/poky/../meta-arm/meta-arm-toolchain \
  /xilinxworks/ZCU102/v2025.2/r5ctrlr/r5ctrlr/yocto/edf/sources/poky/../meta-jupyter \
  /xilinxworks/ZCU102/v2025.2/r5ctrlr/r5ctrlr/yocto/edf/sources/poky/../meta-ros/meta-ros-common \
  /xilinxworks/ZCU102/v2025.2/r5ctrlr/r5ctrlr/yocto/edf/sources/poky/../meta-ros/meta-ros2 \
  /xilinxworks/ZCU102/v2025.2/r5ctrlr/r5ctrlr/yocto/edf/sources/poky/../meta-ros/meta-ros2-jazzy \
  /xilinxworks/ZCU102/v2025.2/r5ctrlr/r5ctrlr/yocto/edf/sources/poky/../meta-qt5 \
  /xilinxworks/ZCU102/v2025.2/r5ctrlr/r5ctrlr/yocto/edf/sources/poky/../meta-vitis \
  /xilinxworks/ZCU102/v2025.2/r5ctrlr/r5ctrlr/yocto/edf/sources/poky/../meta-zephyr/meta-zephyr-core \
  /xilinxworks/ZCU102/v2025.2/r5ctrlr/r5ctrlr/yocto/edf/sources/poky/../meta-zephyr/meta-zephyr-bsp \
  /xilinxworks/ZCU102/v2025.2/r5ctrlr/r5ctrlr/yocto/edf/sources/poky/../meta-rauc \
  /xilinxworks/ZCU102/v2025.2/r5ctrlr/r5ctrlr/yocto/edf/sources/poky/../meta-system-controller \
  /xilinxworks/ZCU102/v2025.2/r5ctrlr/r5ctrlr/yocto/edf/sources/meta-vivadoprj \
  /xilinxworks/ZCU102/v2025.2/r5ctrlr/r5ctrlr/yocto/edf/sources/meta-user \
  "
```
